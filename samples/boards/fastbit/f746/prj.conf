## CMakeLists.txt
```
# Copyright (c) 2026 Fastbit Embedded Technologies Pvt Ltd.
# All rights reserved.
#
# Proprietary and confidential. Use, reproduction, and distribution
# restricted to the terms of the Fastbit Services Agreement.
#
# LCD work for the F746G-DISCO, copied from the ota-lcd project. Source
# reference only -- no entry point (src/main.c) or OTA/WiFi backend
# stand-ins included, so this target does not build/flash standalone.

cmake_minimum_required(VERSION 3.20.5)

find_package(Zephyr REQUIRED HINTS $ENV{ZEPHYR_BASE})
project(fastbit_f746_lcd_work LANGUAGES C)

target_sources(app PRIVATE
    src/main.c
    src/app/lcd_status_wiring_f746g_zephyr.c
    src/app/lcd_logo.c
    src/app/lcd_icon_thermometer.c
    src/app/lcd_hello_f746g_zephyr.c
    src/app/lcd_text.c
    src/app/font5x7.c
)

if(CONFIG_LV_Z_VBD_CUSTOM_SECTION)
    zephyr_linker_sources_ifdef(CONFIG_LV_Z_VBD_CUSTOM_SECTION
        SECTIONS linker/lvgl_buf_f746g.ld)
endif()

target_include_directories(app PRIVATE src)
```

## Kconfig
```
# Copyright (c) 2026 Fastbit Embedded Technologies Pvt Ltd.
# All rights reserved.
#
# Proprietary and confidential. Use, reproduction, and distribution
# restricted to the terms of the Fastbit Services Agreement.
#
# The copied LCD source files reference several app-level Kconfig
# symbols that normally come from the original application's own
# app/Kconfig. Declared standalone here, with the same defaults, so
# the files need zero edits.

mainmenu "Fastbit F746G LCD work"

config APP_LOG_LEVEL
	int
	default 3

config APP_OTA_DEVICE_VERSION
	string "Device firmware version string (display only)"
	default "1.0.0"
	help
	  Shown in the FW: cell on the OTA LCD status screen. No real
	  OTA/anti-rollback meaning here -- the real OTA manager
	  implementation is not included in this copy.

config APP_LCD_TEST
	bool "Standalone LCD bring-up test (Check 6)"
	depends on DISPLAY
	default n
	help
	  Gates the normal LCD bring-up test (lcd_hello_run(), in
	  lcd_hello_f746g_zephyr.c). Matches the original application's
	  own APP_LCD_TEST symbol.

config APP_LCD_STATUS
	bool "Enable LCD OTA status display"
	depends on DISPLAY
	default n
	help
	  Gates the OTA status screen (lcd_status_wiring_init(), in
	  lcd_status_wiring_f746g_zephyr.c). Matches the original
	  application's own APP_LCD_STATUS symbol.

source "Kconfig.zephyr"
```

## prj.conf
```kconfig
# Copyright (c) 2026 Fastbit Embedded Technologies Pvt Ltd.
# All rights reserved.
#
# Proprietary and confidential. Use, reproduction, and distribution
# restricted to the terms of the Fastbit Services Agreement.
#
# Display-only build: the same LVGL/DISPLAY/sensor config proven on real
# hardware in the ota-lcd project's ci/prj_ota_lcd_f746g.conf, minus the
# OTA/WiFi/mbedTLS stack -- this sample shows the LCD work without a real
# OTA backend (see src/app/fake_backend.c for the stand-ins).

CONFIG_LVGL=y
CONFIG_LV_Z_MEM_POOL_SIZE=16384
CONFIG_LV_FONT_MONTSERRAT_14=y
# See lcd_status_wiring_f746g_zephyr.c's own history: full-refresh caused
# a visible full-screen blink on every 1s UPTIME tick on this board.
CONFIG_LV_Z_FULL_REFRESH=n
CONFIG_LV_Z_BITS_PER_PIXEL=16
CONFIG_LV_Z_VBD_CUSTOM_SECTION=y

CONFIG_DISPLAY=y
CONFIG_DISPLAY_LOG_LEVEL_ERR=y

CONFIG_MEMC_STM32=y
CONFIG_MEMC_STM32_SDRAM=y

CONFIG_MAIN_STACK_SIZE=16384

# Touch input -- the board's stock devicetree already wires the FT5336
# capacitive touch controller (I2C3); only these two lines are needed.
CONFIG_INPUT=y
CONFIG_INPUT_FT5336=y

# DHT11 temperature+humidity sensor. Devicetree node in
# boards/stm32f746g_disco.overlay. CONFIG_DHT auto-selects itself once
# that node is enabled; only CONFIG_SENSOR is needed explicitly here.
CONFIG_SENSOR=y

CONFIG_LOG=y
```

## boards/stm32f746g_disco.overlay
```dts
/*
 * Copyright (c) 2026 Fastbit Embedded Technologies Pvt Ltd.
 * All rights reserved.
 *
 * Proprietary and confidential. Use, reproduction, and distribution
 * restricted to the terms of the Fastbit Services Agreement.
 */

/*
 * DHT11 temperature+humidity sensor, single-wire data line on PA0
 * (Arduino header A0) -- confirmed free on this board: not used by
 * LTDC, FMC/SDRAM, the stock user button/LED, or I2C3 touch.
 * GPIO_ACTIVE_LOW matches Zephyr's own DHT sample (samples/sensor/dht)
 * -- the driver measures pulse-low durations to decode bits.
 */
/ {
	dht11: dht11 {
		compatible = "aosong,dht";
		status = "okay";
		dio-gpios = <&gpioa 0 (GPIO_PULL_UP | GPIO_ACTIVE_LOW)>;
	};
};

&ltdc {
	/* Black LTDC FIFO-underrun background, matching the ota-lcd app's
	 * own board overlay -- keeps a brief underrun invisible against
	 * this dark UI instead of showing the stock white default. */
	def-back-color-red = <0x00>;
	def-back-color-green = <0x00>;
	def-back-color-blue = <0x00>;
};
```

## src/main.c
```c
/*
 * Copyright (c) 2026 Fastbit Embedded Technologies Pvt Ltd.
 * All rights reserved.
 *
 * Proprietary and confidential. Use, reproduction, and distribution
 * restricted to the terms of the Fastbit Services Agreement.
 */

/*
 * Entry point reproducing the LCD call pattern from the original
 * application's own main.c: CONFIG_APP_LCD_TEST gates the standalone
 * bring-up test, CONFIG_APP_LCD_STATUS gates the real OTA status
 * screen. The original main.c also wires up app_init(), the watchdog,
 * and demo-mode heartbeat -- none of that is LCD work, so it is not
 * reproduced here; only the two #if blocks below are.
 */

#include <zephyr/kernel.h>

#if IS_ENABLED(CONFIG_APP_LCD_STATUS)
#include "app/lcd_status_wiring.h"
#endif

#if defined(CONFIG_APP_LCD_TEST)
#include "app/lcd_hello.h"
#endif

int main(void)
{
#if defined(CONFIG_APP_LCD_TEST)
    /* Standalone LCD bring-up test. Never returns. */
    lcd_hello_run();
#endif

#if IS_ENABLED(CONFIG_APP_LCD_STATUS)
    lcd_status_wiring_init();
#endif

    while (1) {
        k_msleep(1000);
    }

    return 0;
}
```
